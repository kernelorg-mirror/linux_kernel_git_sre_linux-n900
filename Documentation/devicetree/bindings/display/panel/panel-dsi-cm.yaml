## Documentation/devicetree/bindings/display/panel/panel-dsi-cm.yaml
```yaml
# SPDX-License-Identifier: (GPL-2.0-only or BSD-2-Clause)
%YAML 1.2
---
$id: http://devicetree.org/schemas/display/panel/panel-dsi-cm.yaml#
$schema: http://devicetree.org/meta-schemas/core.yaml#

title: DSI command mode panels

maintainers:
  - Tomi Valkeinen <tomi.valkeinen@ti.com>
  - Sebastian Reichel <sre@kernel.org>

description: |
  This binding file is a collection of the DSI panels that
  are usually driven in command mode. If no backlight is
  referenced via the optional backlight property, the DSI
  panel is assumed to have native backlight support.
  The panel may use an OF graph binding for the association
  to the display, or it may be a direct child node of the
  display.

allOf:
  - $ref: panel-common.yaml#

properties:

  compatible:
    oneOf:
      - items:
        - enum:
          - motorola,droid4-panel        # Panel from Motorola Droid4 phone
          - nokia,himalaya               # Panel from Nokia N950 phone
          - tpo,taal                     # Panel from OMAP4 SDP board
        - const:
          - panel-dsi-cm                 # Generic DSI command mode panel compatible fallback

  reg:
    maxItems: 1
    description: DSI virtual channel

  te-gpios:
    maxItems: 1
    description:
      Specifier for a GPIO connected to the panel TE (tearing event) signal.
      The GPIO informs the system, that data should be sent to the display
      on rising edges of the GPIO to avoid (or reduce) tearing effects.
      Falling edge can be supported by inverting the GPIO specifier polarity
      flag.

  vddi-supply:
    description:
      Display panels require power to be supplied. While several panels need
      more than one power supply with panel-specific constraints governing the
      order and timings of the power supplies, in many cases a single power
      supply is sufficient, either because the panel has a single power rail, or
      because all its power rails can be driven by the same supply. In that case
      the vddi-supply property specifies the supply powering the panel as a
      phandle to a regulator.

  vpnl-supply:
    description:
      When the display panel needs a second power supply, this property can be
      used in addition to vddi-supply. Both supplies will be enabled at the
      same time before the panel is being accessed.

  width-mm: true
  height-mm: true
  label: true
  rotation: true
  panel-timing: true
  port: true
  reset-gpios: true
  backlight: true

additionalProperties: false

required:
  - compatible
  - port
  - reg

examples:
  - |
    dsi1@12345678 {
      #address-cells = <1>;
      #size-cells = <0>;
      panel@0 {
        compatible = "tpo,taal", "panel-dsi-cm";
        label = "lcd0";
        reg = <0>;
        reset-gpios = <&gpio4 6 GPIO_ACTIVE_HIGH>;

        port {
          panel: endpoint {
            remote-endpoint = <&dsi1_out_ep>;
          };
        };
      };
    };
```

## Documentation/devicetree/bindings/i2c/i2c-sc18is600.txt
```
NXP SC18IS600 and Silabs CP2120 - SPI to I2C bus bridge

NXP SC18IS600 is a SPI slave chip, which implements an I²C host,
also known as SPI to I²C bus bridge. SC18IS601 is the same chip,
but has an external clock input instead of using a builtin
oscillator. CP2120 is a similar chip from Silabs, which implements
the same interface as NXP's SC18IS600.

Required properties:
  - compatible: Should contain one of
      * "nxp,sc18is600"
      * "nxp,sc18is601"
      * "silabs,cp2120"
  - reg: address of the chip on SPI bus
  - interrupts: Interrupt specifier. Refer to interrupt bindings.
  - #address-cells: Should be 1.
  - #size-cells: Should be 0.

Required properties for sc18is601:
  - clkin: Clock specifier for CLKIN pin

Optional properties:
  - clock-frequency:
    Desired I2C bus frequency in Hz, otherwise defaults to 100 KHz
  - reset-gpios
    GPIO specifier for reset pin, which is active low.
  - vdd-supply
    Regulator specifier for VDD supply (3.3V).
  - Child nodes conforming to i2c bus binding

Example:

&spi_controller {
	sc18is600: i2c@0 {
		compatible = "nxp,sc18is600";
		spi-max-frequency = <700000>; /* 700KHz */
		spi-cpol;
		spi-cpha;
		reg = <0>;

		vdd-supply = <&regulator_v33>;

		interrupt-parent = <&socgpio>;
		interrupts = <25 0x2>;

		reset-gpios = <&i2cgpio1 9 GPIO_ACTIVE_LOW>;

		clock-frequency = <100000>; /* 100KHz */

		#address-cells = <0x1>;
		#size-cells = <0x0>;
	};
};

&sc18is600 {
	i2c_device@42 {
		compatible = "some,i2c-device";
		reg = <0x42>;
	};

	...
};
```

## Documentation/devicetree/bindings/iio/light/isl29030.txt
```
* ISL 29030 I2C ALS, Proximity, and Infrared sensor

Required properties:

  - compatible: Should be "isil,isl29030"
  - reg: the I2C address of the device
  - interrupt-parent: should be the phandle for the interrupt controller
  - interrupts: the sole interrupt generated by the device

Optional properties:

  - vdd-supply: phandle to the regulator that provides power to the sensor.
  - isil,ir-led-microamp: may be either 110000 or 220000, defaults to 110000.

Example:

isl29018@44 {
	compatible = "isil,isl29030";
	reg = <0x44>;
	interrupt-parent = <&gpio6>;
	interrupts = <17 IRQ_TYPE_LEVEL_LOW>; /* gpio177 */
	isil,ir-led-microamp = <110000>;
};
```

## Documentation/devicetree/bindings/input/pwm-vibrator.txt
```
* PWM vibrator device tree bindings

Registers a PWM device as vibrator.

Required properties:
- compatible: should be "pwm-vibrator"
- pwms: PWM handle for the physical PWM device

Optional property:
- direction-pwms: PWM handle controlling the vibrators direction,
                  that should be driven with 50% duty cycle when
		  vibrator is enabled.

Example from Motorola Droid 4:

&omap4_pmx_core {
	vibrator_direction_pin: pinmux_vibrator_direction_pin {
		pinctrl-single,pins = <
		OMAP4_IOPAD(0x1ce, PIN_OUTPUT | MUX_MODE1) /* dmtimer8_pwm_evt (gpio_27) */
		>;
	};

	vibrator_enable_pin: pinmux_vibrator_enable_pin {
		pinctrl-single,pins = <
		OMAP4_IOPAD(0X1d0, PIN_OUTPUT | MUX_MODE1) /* dmtimer9_pwm_evt (gpio_28) */
		>;
	};
};

/ {
	pwm8: dmtimer-pwm {
		pinctrl-names = "default";
		pinctrl-0 = <&vibrator_direction_pin>;

		compatible = "ti,omap-dmtimer-pwm";
		#pwm-cells = <3>;
		ti,timers = <&timer8>;
		ti,clock-source = <0x00>; /* timer_sys_ck */
	};

	pwm9: dmtimer-pwm {
		pinctrl-names = "default";
		pinctrl-0 = <&vibrator_enable_pin>;

		compatible = "ti,omap-dmtimer-pwm";
		#pwm-cells = <3>;
		ti,timers = <&timer9>;
		ti,clock-source = <0x00>; /* timer_sys_ck */
	};

	vibrator {
		compatible = "pwm-vibrator";
		pwms = <&pwm8 0 40000000 0>,
		       <&pwm9 0 40000000 0>;
	};
};
```

## Documentation/devicetree/bindings/net/nokia-bluetooth.txt
```
Nokia bluetooth UART devices
------

Some vendors have custom versions of their chips, that can be found in Nokia
devices. These chips are controlled differently, than the non-Nokia version,
so a different binding is required. All chips listed here implement the Nokia
H4+ protocol.

Required properties:

  - compatible: should be one of the following:
	* "nokia,brcm,bcm2048"
	* "nokia,ti,wl1271-bluetooth"
  - reset-gpios:		Should specify the gpio for bluetooth reset
  - host-wakeup-gpios:		Should specify the gpio for host wakeup
  - bluetooth-wakeup-gpios:	Should specify the gpio for bluetooth wakeup
  - clock-names:		Should be "sysclk"
  - clocks:			Should contain a clock phandle for system clock

Example:

/ {
	/* controlled (enabled/disabled) directly by wl1271 */
	vctcxo: vctcxo {
		compatible = "fixed-clock";
		#clock-cells = <0>;
		clock-frequency = <38400000>;
	};
};

&uart2 {
	bluetooth {
		compatible = "nokia,ti,wl1271-bluetooth";

		reset-gpios = <&gpio1 26 GPIO_ACTIVE_HIGH>; /* 26 */
		host-wakeup-gpios = <&gpio4 5 GPIO_ACTIVE_HIGH>; /* 101 */
		bluetooth-wakeup-gpios = <&gpio2 5 GPIO_ACTIVE_HIGH>; /* 37 */

		clocks = <&vctcxo>;
		clock-names = "sysclk";
	};

};
```
